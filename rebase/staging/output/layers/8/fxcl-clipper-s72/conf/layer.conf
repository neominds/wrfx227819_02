## rebase/staging/output/layers/8/fxcl-clipper-s72/conf/layer.conf
```bitbake
#
# Copyright (C) 2013 Wind River Systems, Inc.
#
BBPATH ?= ""
# We have a conf and classes directory, add to BBPATH
BBPATH := "${LAYERDIR}:${BBPATH}"

# We have a packages directory, add to BBFILES
BBFILES := "${BBFILES} ${LAYERDIR}/recipes-*/*/*.bb \
	${LAYERDIR}/recipes-*/*/*.bbappend \
	${LAYERDIR}/classes/*.bbclass"

BBFILE_COLLECTIONS += "fxcl-clipper-s72"
BBFILE_PATTERN_fxcl-clipper-s72 := "^${LAYERDIR}/"
BBFILE_PRIORITY_fxcl-clipper-s72 = "7"

# Let the "No recipes available for: pkg.bbappend" be WARNINGS
BB_DANGLINGAPPENDS_WARNONLY ?= "true"

include conf/wr.conf

# This should only be incremented on significant changes that will
# cause compatibility issues with other layers
LAYERVERSION_fxcl-clipper-s72 = "1"

LAYERDEPENDS_fxcl-clipper-s72 = "wr-kernel core"
```

## rebase/staging/output/layers/8/fxcl-clipper-s72/conf/machine/fxcl-clipper-s72.conf
```bitbake
#@TYPE: Machine
#@NAME: fxcl-clipper-s72 
#@DESCRIPTION: fxcl-clipper-s72
require conf/machine/include/tune-cortexa15.inc

MACHINE_FEATURES = "usbhost jffs2 ext2 pci"
#QSPI flash has 64kB erase size
EXTRA_IMAGECMD_jffs2 = "-lnp -e64KiB"

KERNEL_IMAGETYPE = "zImage"

SERIAL_CONSOLE = "115200 ttyPS0"

PREFERRED_VERSION_linux-windriver_forcevariable ?= "3.10%"
```
